#include "ESP8266WiFi.h"
#include <WiFiHelper.h>


// OLED Library
#include <Wire.h>
#include <Adafruit_GFX.h>
#include <ESP_Adafruit_SSD1306.h>
 
#define OLED_RESET 4
Adafruit_SSD1306 display(OLED_RESET);

const char* ssid = "HOM-IoT";
const char* pass = "123456789";

WiFiHelper *wifi;

//Get Web Info

const char *host = "api.wunderground.com";
const int httpPort = 80;
const char *path = "/api/dd6379ff91d93f3a/conditions/q/Thailand/Bangkok.json";
//http://api.wunderground.com/api/dd6379ff91d93f3a/conditions/q/Thailand/Bangkok.json
//http://www.wunderground.com/?MR=1


//const char server[] = "api.wunderground.com";    // name address for Weather Underground (using DNS)
//const String myKey = "dd6379ff91d93f3a";  //See: http://www.wunderground.com/weather/api/d/docs (change here with your KEY)
//const String myFeatures = "conditions";   //See: http://www.wunderground.com/weather/api/d/docs?d=data/index&MR=1
//const String myCountry = "Thailand";        //See: http://www.wunderground.com/weather/api/d/docs?d=resources/country-to-iso-matching
//const String myCity = "Bangkok";      //See: http://www.wunderground.com/weather/api/d/docs?d=data/index&MR=1


//Response from Server
String responseString;
 
boolean startCapture;

//Weather Rain
//Byte array of bitmap of 48 x 50 px:   
byte img2 [] = { 
0x0, 0x0, 0x0, 0x0, 0x0, 0x0, 0x0, 0x0, 0x0, 0x0, 0x0, 0x0, 0x0, 0x0, 0x0, 
0x0, 0x0, 0x0, 0x0, 0x0, 0x0, 0x0, 0x0, 0x0, 0x0, 0x0, 0xf, 0xf0, 0x0, 0x0, 
0x0, 0x0, 0x3f, 0xfc, 0x0, 0x0, 0x0, 0x0, 0xff, 0xff, 0x0, 0x0, 0x0, 0x1, 0xfc, 
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0x0, 0x0, 0x0, 0x0, 0x0, 0x0, 0x0, 0x0, 0x0, 0x0, 0x0, 0x0, 0x0, 0x0, 0x0, 
 };


//G Sign
//Byte array of bitmap of 32 x 32 px:
byte img [] = { 
0x00, 0x00, 0x00, 0x00, 
0x00, 0x00, 0x00, 0x00, 0x00, 0x00, 0x1C, 0x00, 0x00, 0x00, 0x7C, 0x00, 0x00, 0x03, 0xFC, 0x00,
0x00, 0x0F, 0xFC, 0x00, 0x00, 0x3F, 0xFC, 0x00, 0x00, 0xFF, 0xF8, 0x00, 0x01, 0xFF, 0xC0, 0x00,
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0x03, 0xFF, 0xFC, 0x00, 0x01, 0xFF, 0xF0, 0x00, 0x00, 0x7F, 0x80, 0x00, 0x00, 0x00, 0x00, 0x00
 };

//Byte array of bitmap of 32 x 32 px:
byte weather_img [] = {
0x0, 0x0, 0x0, 0x0, 0x0, 0x1, 0xc0, 0x0, 0x0, 0x7, 0xf0, 0x0, 0x0, 0x7, 0x78, 
0x0, 0x0, 0xe, 0x18, 0x0, 0x0, 0xc, 0x18, 0x0, 0x0, 0xc, 0x18, 0x0, 0x0, 0xc, 
0x18, 0x0, 0x0, 0xc, 0x18, 0x0, 0x0, 0xc, 0x18, 0x0, 0x0, 0xc, 0x18, 0x0, 0x0, 
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0x0, 0x3, 0xf0, 0x0, 0x0, 0x0, 0x0, 0x0, 
};

//Byte array of bitmap of 56 x 50 px:
byte weather_img2 [] = { 
0x0, 0x0, 0x0, 0x0, 0x0, 0x0, 0x0, 0x0, 0x0, 0x0, 0x0, 0x0, 0x0, 0x0, 0x0, 
0x0, 0x0, 0x0, 0x0, 0x0, 0x0, 0xf, 0xc0, 0x0, 0x0, 0x0, 0x0, 0xf, 0xf8, 0x0, 
0x0, 0x0, 0x0, 0x7, 0xff, 0x0, 0x0, 0x0, 0x0, 0x1, 0xf3, 0xe0, 0x0, 0x0, 0x0, 
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0x0, 0x0, 0x0, 0x0, 0x0, 0x0, 0x0, 0x0, 0x0, 0x0, 0x0, 0x0, 0x0, 
 };


//Byte array of bitmap of 120 x 60 px:
byte eyes [] = { 
0x0, 0x0, 0x0, 0x0, 0x0, 0x0, 0x0, 0x0, 0x0, 0x0, 0x0, 0x0, 0x0, 0x0, 0x0, 
0x0, 0x0, 0x0, 0x0, 0x0, 0x0, 0x0, 0x0, 0x0, 0x0, 0x0, 0x0, 0x0, 0x0, 0x0, 
0x0, 0x0, 0x0, 0x0, 0x0, 0x0, 0x0, 0x0, 0x0, 0x0, 0x0, 0x0, 0x0, 0x0, 0x0, 
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0x0, 0x0, 0x0, 0x0, 0x0, 0x0, 0x0, 0x0, 0x0, 0x0, 0x0, 0x0, 0x0, 0x0, 0x0,
 };



//Byte array of bitmap of 120 x 60 px:
//baymax
byte eyes1 [] = { 
0x0, 0x0, 0x0, 0x0, 0x0, 0x0, 0x0, 0x0, 0x0, 0x0, 0x0, 0x0, 0x0, 0x0, 0x0, 
0x0, 0x0, 0x0, 0x0, 0x0, 0x0, 0x0, 0x0, 0x0, 0x0, 0x0, 0x0, 0x0, 0x0, 0x0, 
0x0, 0x0, 0x0, 0x0, 0x0, 0x0, 0x0, 0x0, 0x0, 0x0, 0x0, 0x0, 0x0, 0x0, 0x0, 
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0x0, 0x0, 0x0, 0x0, 0x0, 0x0, 0x0, 0x0, 0x0, 0x0, 0x0, 0x0, 0x0, 0x0, 0x0, 

 };

//Byte array of bitmap of 120 x 60 px:
byte eyes_eve_normal [] = { 
0x0, 0x0, 0x0, 0x0, 0x0, 0x0, 0x0, 0x0, 0x0, 0x0, 0x0, 0x0, 0x0, 0x0, 0x0, 
0x0, 0x0, 0x0, 0x0, 0x0, 0x0, 0x0, 0x0, 0x0, 0x0, 0x0, 0x0, 0x0, 0x0, 0x0, 
0x0, 0x0, 0x0, 0x0, 0x0, 0x0, 0x0, 0x0, 0x0, 0x0, 0x0, 0x0, 0x0, 0x0, 0x0, 
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0x0, 0x0, 0x0, 0x0, 0x0, 0x0, 0x0, 0x0, 0x0, 0x0, 0x0, 0x0, 0x0, 0x0, 0x0, 
 };

//Byte array of bitmap of 120 x 60 px:
byte eyes_eve_smile [] = { 
0x0, 0x0, 0x0, 0x0, 0x0, 0x0, 0x0, 0x0, 0x0, 0x0, 0x0, 0x0, 0x0, 0x0, 0x0, 
0x0, 0x0, 0x0, 0x0, 0x0, 0x0, 0x0, 0x0, 0x0, 0x0, 0x0, 0x0, 0x0, 0x0, 0x0, 
0x0, 0x0, 0x0, 0x0, 0x0, 0x0, 0x0, 0x0, 0x0, 0x0, 0x0, 0x0, 0x0, 0x0, 0x0, 
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0x0, 0x0, 0x0, 0x0, 0x0, 0x0, 0x0, 0x0, 0x0, 0x0, 0x0, 0x0, 0x0, 0x0, 0x0, 

 }; 
void setup() {
  Serial.begin(9600); 
  Serial.println("Init!");

  // set display
  display.begin(SSD1306_SWITCHCAPVCC, 0x78>>1);
  //Rotate screen 180
  display.setRotation(2);
  display.display();
  delay(2000);
  display.clearDisplay();

   responseString = "";
   startCapture = false; 

    //Init Wifi
  init_wifi();
}
 

 
void loop() {

  wifi->loop();
  
 // Display Gravitech Logo
  gtech_logo();
  delay(2000);

  showEyes();
  delay(2000);

 //Get Weather
 getData();
 //delay(2000);

  

 showLocation();
 delay(2000);

 showEyesEve();
 delay(2000);

 // Display Temperature
 showTemp();
 delay(2000);

 showEyesEve2();
 delay(2000);

 showWeather();
 delay(2000);

 showEyes1();
  delay(2000);
}


void gtech_logo(){

  display.drawBitmap(0,16,img,32,32,1);
  display.setTextSize(2);
  display.setTextColor(WHITE);
  display.setCursor(32,20);
  display.print("ravitech");
  
  display.setTextSize(1);
  display.setTextColor(WHITE);
  display.setCursor(33,40);
  display.print("Home of Maker");
  display.display();
  display.clearDisplay();
}



void init_wifi()
{
  wifi = new WiFiHelper(ssid, pass);

  wifi->on_connecting([](const char* message)
  {
      Serial.println (message);
      display.setTextSize(1);
      display.setTextColor(WHITE);
      display.setCursor(0,20);
      display.print(message);
      display.display();
      delay(1000);
      display.clearDisplay(); 
  });

  wifi->on_connected([](const char* message)
  {
      Serial.println (message);
      Serial.println("IP address: ");
      Serial.println(WiFi.localIP());   

      display.setTextSize(1);
      display.setTextColor(WHITE);
      display.setCursor(0,30);
      //display.print(message);
      display.print("IP: ");
      display.print(WiFi.localIP());
      display.display();
      delay(5000);
      display.clearDisplay();     
  });

  wifi->on_disconnected([](const char* message)
  {
      Serial.println (message);
      display.setTextSize(1);
      display.setTextColor(WHITE);
      display.setCursor(0,0);
      display.print(message);
      display.display();
      delay(2000);
      display.clearDisplay();
  });
  
  wifi->begin();
}

void getData(){

  Serial.print( "Connecting to " );
  Serial.println( host );

  WiFiClient client;
  if( !client.connect( host, httpPort ) ) {
    Serial.println( "Connection failed" );
    return;
  }

  Serial.print( "Requesting URL: " );
  Serial.print( host );
  Serial.println( path );

  client.print( String( "GET " ) + path + " HTTP/1.1\r\n" +
    "Host:" + host + "\r\n" +
    "Connection: close\r\n\r\n" );
  delay( 1000 );

  


  while( client.available() ) {
   // String line = client.readStringUntil( '\r' );
    //Serial.print( line );

    // if there are incoming bytes available 
    // from the server, read them and buffer:
    char c = client.read();
    if(c == '{')
      startCapture=true;
    
    if(startCapture)
      responseString += c;

  }

    // if the server's disconnected, stop the client:
  if (!client.connected()) {    
    Serial.println("Received " + (String)responseString.length() + " bytes");
    Serial.println("Disconnecting.");
    client.stop();
    client.flush();
    
    Serial.println();
    
    //Now, some examples of how to use it!
    Serial.print("Weather: ");
    Serial.println(getValuesFromKey(responseString, "weather"));
    Serial.println();
    
    Serial.print("Current Temperature: ");
    Serial.print(getValuesFromKey(responseString, "temp_c"));
    Serial.println(" oC\n");
    
    Serial.print("Relativy Humidity: ");
    Serial.println(getValuesFromKey(responseString, "relative_humidity"));
    Serial.println();
    
    Serial.print("Wind: ");
    Serial.println(getValuesFromKey(responseString, "wind_string"));
    Serial.println();
    
    Serial.print("Feels like: ");
    Serial.print(getValuesFromKey(responseString, "feelslike_c"));
    Serial.println(" oC\n");
    
    // do nothing forevermore:
    //while(true);
  }


  Serial.println( "-" );
  Serial.println( "closing connection" );
  delay( 5000 );  
}

String getValuesFromKey(const String response, const String sKey)
{ 
  String sKey_ = sKey;
  
  sKey_ = "\"" + sKey + "\":";
  
  char key[sKey_.length()];
  
  sKey_.toCharArray(key, sizeof(key));
  
  int keySize = sizeof(key)-1;
    
  String result = "";
  
  int n = response.length();
  
  for(int i=0; i < (n-keySize-1); i++)
  {
    char c[keySize];
    
    for(int k=0; k<keySize; k++)
    {
      c[k] = response.charAt(i+k);
    }
        
    boolean isEqual = true;
    
    for(int k=0; k<keySize; k++)
    {
      if(!(c[k] == key[k]))
      {
        isEqual = false;
        break;
      }
    }
    
    if(isEqual)
    {     
      int j= i + keySize + 1;
      while(!(response.charAt(j) == ','))
      {
        result += response.charAt(j);        
        j++;
      }
      
      //Remove char '"'
      result.replace("\"","");
      break;
    }
  }
  
  return result;
}

void showWeather(){

  Serial.print("Weather: ");
  Serial.println(getValuesFromKey(responseString, "weather"));
  Serial.println();
  
  display.setTextSize(1);
  display.setTextColor(WHITE);
  display.setCursor(0,10);
  display.print("Weather Today : ");
  display.setCursor(0,20);
  display.setTextSize(2);
  display.print(getValuesFromKey(responseString, "weather"));
  display.display();
  delay(2000);
  display.clearDisplay();

}

void showTemp() {
  //float temp = 23.5;
  //float hud = 53.2;
  Serial.print("Temperature: ");
  Serial.println(getValuesFromKey(responseString, "temp_c"));
  Serial.println();
  Serial.print("Humidity: ");
  Serial.println(getValuesFromKey(responseString, "relative_humidity"));
  Serial.println();

  //Byte array of bitmap of 48 x 50 px: 
  //display.drawBitmap(0, 5,  img2, 48, 50, 1);
  //Byte array of bitmap of 56 x 50 px:
  //byte weather_img2 [] = { 
  display.drawBitmap(0, 15,  weather_img, 32, 32, 1);
// text display tests
  display.setTextSize(2);
  display.setTextColor(WHITE);
  display.setCursor(52,10);
  display.print(getValuesFromKey(responseString, "temp_c"));
  display.println("C");
  display.setCursor(52,30);
  display.print(getValuesFromKey(responseString, "relative_humidity"));
  display.display();
  display.clearDisplay();
  
}


void showLocation(){

  Serial.print("Location : ");
  Serial.println(getValuesFromKey(responseString, "city"));
  Serial.println();
  Serial.println(getValuesFromKey(responseString, "state_name"));
  Serial.println();
  
  display.setTextSize(1);
  display.setTextColor(WHITE);
  display.setCursor(0,10);
  display.print("You're at : ");
  display.setCursor(0,20);
  display.setTextSize(2);
  display.print(getValuesFromKey(responseString, "city"));
  display.setCursor(0,40);
  display.setTextSize(2);
  display.print(getValuesFromKey(responseString, "state_name"));
  display.display();
  delay(2000);
  display.clearDisplay();

}

void showEyes(){
   display.drawBitmap(0, 0, eyes, 120, 60, 1);
   display.display();
   display.clearDisplay();
}

void showEyes1(){
   display.drawBitmap(0, 0, eyes1, 120, 60, 1);
   display.display();
   display.clearDisplay();
}

void showEyesEve(){
   display.drawBitmap(0, 0, eyes_eve_normal, 120, 60, 1);
   display.display();
   display.clearDisplay();
}

void showEyesEve2(){
   display.drawBitmap(0, 0, eyes_eve_smile, 120, 60, 1);
   display.display();
   display.clearDisplay();
}


